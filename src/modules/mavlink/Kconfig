## src/modules/mavlink/Kconfig
```kconfig
menuconfig MODULES_MAVLINK
	bool "mavlink"
	default n
	---help---
		Enable support for mavlink

menuconfig MAVLINK_DIALECT
depends on MODULES_MAVLINK
        string "Mavlink dialect"
        default "common"
	---help---
		Select the Mavlink dialect to generate and use.

menuconfig MAVLINK_UAVCAN_PARAMETERS
depends on MODULES_MAVLINK && DRIVERS_UAVCAN
        bool "Mavlink UAVCAN parameter support"
        default y
	---help---
		Expose UAVCAN parameters over Mavlink.

menuconfig USER_MAVLINK
	bool "mavlink running as userspace module"
	default y
	depends on BOARD_PROTECTED && MODULES_MAVLINK
	---help---
		Put mavlink in userspace memory

menuconfig FORCE_HIL_MAVLINK
    bool "Force HIL mode to be enabled on MAVLink channels"
    default n
    depends on MODULES_MAVLINK
    --help--
        Guarantee that HIL mode will be enabled on MAVLink channels. To be used by IRPAS for SITL and HITL testing.
```
